## charged/evidence/RESUMED_20260910_1617/linux_dentry_01/implementation02/Kconfig.append
```kconfig
config D_PATH_KUNIT_TEST
	bool "Source integration test of dentry path retry policies"
	depends on KUNIT=y
	default n
	help
	  Author exploratory KUnit matrix. Not a production policy replacement.
```
